## drivers/clk/sbi/Kconfig
```kconfig
# SPDX-License-Identifier: GPL-2.0

menuconfig CLK_SBI
	bool "RISC-V SBI clock framework support"
	depends on RISCV || COMPILE_TEST
	help
	  Clock drivers for RISC-V SBI clock frameowrk compatible SoCs.

if CLK_SBI

config CLK_SBI_DUOWEN
	bool "SmarCo DUOWEN SBI clock (CRCNTL) support"
	select SOC_SMARCO_DUOWEN
	help
	  Supports the Clock and Reset control (CRCNTL) IP block found in
	  DUOWEN platform.

endif
```

## drivers/pinctrl/sbi/Kconfig
```kconfig
# SPDX-License-Identifier: GPL-2.0

menuconfig PINCTRL_SBI
	tristate "RISC-V SBI based pinctrl driver"
	depends on RISCV || COMPILE_TEST
	depends on OF
	select GENERIC_PINCTRL_GROUPS
	select GENERIC_PINMUX_FUNCTIONS
	select GENERIC_PINCONF
	help
	  This selects the device tree based RISC-V SBI pinctrl driver.

if PINCTRL_SBI

config PINCTRL_SBI_DUOWEN
	bool "SmarCo DUOWEN SBI pinctrl (TLMM) support"
	select SOC_SMARCO_DUOWEN
	help
	  Supports the Top Level Multiplexer Module (TLMM) IP block found
	  in DUOWEN platform.

endif
```
